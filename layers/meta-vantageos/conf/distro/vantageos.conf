## layers/meta-vantageos/conf/layer.conf
```bitbake
# We need a BBFILE_PATTERN for this layer
BBFILE_PATTERN_vantageos = "^${LAYERDIR}/"

# Define the priority for this layer
BBFILE_PRIORITY_vantageos = "6"

# This layer depends on OpenEmbedded
LAYERSERIES_COMPAT_vantageos = "kirkstone langdale mickledore nanbield scarthgap"

# This directory
LAYERDIR := "${THISDIR}"

# Add this layer to BBPATH
BBPATH .= ":${LAYERDIR}"

# Add recipes to BBFILES
BBFILES += "${LAYERDIR}/recipes-*/*/*.bb ${LAYERDIR}/recipes-*/*/*.bbappend"

# Collection name
BBFILE_COLLECTIONS += "vantageos"
```
